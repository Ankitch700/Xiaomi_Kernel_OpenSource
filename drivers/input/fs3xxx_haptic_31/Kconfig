## drivers/input/fs3xxx_haptic_31/Kconfig
```kconfig
config INPUT_FS3XXX_HAPTIC
	tristate "Foursemi FS3XXX haptic driver"
	depends on I2C
	help
	  Say Y here if you have Foursemi FS3XXX haptic controller
	  chip in your system.
	  If unsure, say N.
	  To compile this driver as a module, choose M here: the
	  module will be called FS3XXX haptic driver.
```

## drivers/misc/mediatek/typec/tcpc/Kconfig
```kconfig
#
# TypeC Port Controller Device Configuration
#

config TCPC_CLASS
	tristate "TypeC Port Controller Device Class"
	select MTK_USB_TYPEC
	select RT_REGMAP
	select TYPEC
	help
	  Say Y to enable
	  Typec Port
	  Controller Device
	  Class

config USB_POWER_DELIVERY
	tristate "Support USB power delivery Function"
	depends on TCPC_CLASS
	default n
	help
	  Say Y to enable
	  USB
	  Power Delivery
	  support

config DUAL_ROLE_USB_INTF
	tristate "Support DUAL ROLE USB INTF Function"
	depends on TCPC_CLASS
	default n
	help
	  Say Y to enable
	  Dual Role USB Intf
	  support

config TCPC_RT1711H
	tristate "Richtek RT1711H TypeC port Controller Driver"
	depends on TCPC_CLASS
	default n
	help
	  Say Y to enable
	  Richtek RT1711H
          TypeC port Controller
 	  Driver

config TCPC_SC660X
	tristate "SouthChip SC660X TypeC port Controller Driver"
	depends on TCPC_CLASS
	default n
	help
	  Say Y to enable
	  SouthChip SC660X
	  TypeC port Controller
	  Driver

#config TCPC_NU660X
#	tristate "NU NU660X TypeC port Controller Driver"
#	depends on TCPC_CLASS
#	default n
#	help
#	  Say Y to enable
#	  SouthChip NU660X
#	  TypeC port Controller
#	  Driver
          
config USB_PD_VBUS_STABLE_TOUT
	int "PD VBUS Stable Timeout"
	depends on USB_POWER_DELIVERY
	range 0 1000                       # >= 0,  <= 1000
	default 125
	help
	  Setup a timeout value (ms)
	  for
	  VBUS change
	  stable
          
config PD_DBG_INFO
	tristate "PD debug information"
	depends on TCPC_CLASS
	default y
	help
	  Say Y to enable PD debug
	  information
	  Say N to disable

# N6R code for HQ-429228 at 2024/10/31 by p-mazhuang3 start 
#config PR_SWAP_FOR_NU6601
#	tristate "power role swap for nu6601"
#	default n
#	help
#	  Say Y to use power role swap logic for nu6601.

config MTK_TYPEC_WATER_DETECT
	tristate "Water detection function for type-c connector"
	depends on TCPC_CLASS
	help
	  Say Yes to enable water detection on type-c connector.
	  If water is detected on the connector, it will show
	  warning to notify end user.
	  If unsure, say N.

# N6R code for HQ-429228 at 2024/10/31 by p-mazhuang3 end

  
      
```

## drivers/power/supply/hq_chg/charger_policy/Kconfig
```kconfig
#SPDX-License-Identifier: GPL-2.0

config HUAQIN_CHARGER_MANAGER
	tristate "support hauqin charger manger"
	default n
	help
		Say Y here to support hauqin charger manger.

config HUAQIN_CP_POLICY
	tristate "support hauqin charger pump policy"
	default n
	help
		Say Y here to support hauqin charger class.

config HUAQIN_QC_POLICY
	tristate "support hauqin qc policy"
	default n
	help
		Say Y here to support hauqin charger class.
```

## drivers/xiaomi/hangdetect/Kconfig
```kconfig
config MI_HANG_DETECT
	tristate "hang detect monitor"
	help
	  qcom platform hang detect.

config MI_HANG_DETECT_LOG
	bool "hang detect debug log"
	help
	  if you select this option, print debug hang log to kernel log.
```

## sound/soc/codecs/fs1815/Kconfig
```kconfig
config SND_SOC_FS1815
	tristate "FourSemi FS1815 speaker amplifier"
	depends on I2C
	help
	  Config of FourSemi FS1815 speaker amplifier.
```
