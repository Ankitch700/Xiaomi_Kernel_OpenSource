&hq_chg_manager {
    hq_chg_manager,cyclecount = <100 300 800 65535>;
    hq_chg_manager,dropfv = <0 20 20 40>;

    hq,pd-thermal-mitigation-fast = <12200 11000 10000 8800 8000
                                7400 7000 6000 4000 3000
                                2500 2300 2100 2000 1800
                                1600 1400 800 500>;
};