&hq_chg_manager {
    hq,thermal-enable;
    hq,pd-thermal-mitigation = <12200 10000 9000 7800 7000
                                6400 6000 5000 4000 3000
                                2500 2300 2100 2000 1800
                                1600 1400 800 500>;
    hq,qc2-thermal-mitigation = <3000 2700 2500 2300 2100
                                1900 1700 1500 1200 1100
                                1000 1000 1000 1000 1000
                                900 900 500 300>;
};